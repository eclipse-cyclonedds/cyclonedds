## CMakeLists.txt
```
cmake_minimum_required(VERSION 3.25.0)

# Uncomment for (gdbserver) debugging
if(BOARD MATCHES "qemu_.*")
  list(APPEND QEMU_EXTRA_FLAGS -serial tcp:127.0.0.1:5678,server)
endif()

find_package(Zephyr REQUIRED HINTS $ENV{ZEPHYR_BASE})
project(dds_examples)

include(ExternalProject)
include(CMakePrintHelpers)

set(BUILD_DDSPERF_PING 0 CACHE BOOL "Build the CycloneDDS DDSPerf tool (ping mode)")
set(BUILD_DDSPERF_PONG 0 CACHE BOOL "Build the CycloneDDS DDSPerf tool (pong mode)")
set(BUILD_ROUNDTRIP_PING 0 CACHE BOOL "Build the CycloneDDS Roundtrip Ping example")
set(BUILD_ROUNDTRIP_PONG 0 CACHE BOOL "Build the CycloneDDS Roundtrip Pong example")
set(BUILD_THROUGHPUT_PUB 0 CACHE BOOL "Build the CycloneDDS Throughput Publisher example")
set(BUILD_THROUGHPUT_SUB 0 CACHE BOOL "Build the CycloneDDS Throughput Subscriber example")
set(BUILD_HELLOWORLD_PUB 0 CACHE BOOL "Build the CycloneDDS Hello World Publisher example")
set(BUILD_HELLOWORLD_SUB 0 CACHE BOOL "Build the CycloneDDS Hello World Subscriber example")

function(GENERATE_CDDS_CONF XML_FILE OUTPUT_FILE)
  message("Generate static CycloneDDS config (${XML_FILE} -> ${OUTPUT_FILE})")

  # Strip one-line comments, newlines, whitespace
  #file(READ ${XML_FILE} xmlout)
  #string(REGEX REPLACE "<!--[^\r\n]*-->" "" xmlout ${xmlout})
  #string(REGEX REPLACE "(\r?\n)+" "" xmlout ${xmlout})
  #string(REGEX REPLACE ">[ ]+<" "" xmlout ${xmlout})

  find_program(xxd xxd REQUIRED)
  execute_process(
    COMMAND ${xxd} -i
    INPUT_FILE ${XML_FILE}
    OUTPUT_VARIABLE conf_data
    OUTPUT_STRIP_TRAILING_WHITESPACE
    COMMAND_ERROR_IS_FATAL ANY)

  # Convert the string "CYCLONEDDS_URI=" to C array of bytes
  string(HEX "CYCLONEDDS_URI=" conf_prefix)
  string(REGEX MATCHALL "([A-Fa-f0-9][A-Fa-f0-9])" conf_prefix ${conf_prefix})
  list(JOIN conf_prefix ", 0x" conf_prefix)
  string(PREPEND conf_prefix "  0x")

  # Write to output file
  file(WRITE ${OUTPUT_FILE}
    "unsigned char cdds_xml_config[] = {\n"
    ${conf_prefix} ",\n"
    ${conf_data} ", 0\n"
    " };\n")
endfunction()

zephyr_get_system_include_directories_for_lang_as_string(C ext_system_includes)
zephyr_get_include_directories_for_lang_as_string(C ext_includes)
zephyr_get_compile_definitions_for_lang_as_string(C ext_defs)
zephyr_get_compile_options_for_lang_as_String(C ext_opts)
set(CDDS_CFLAGS
    "${ext_defs} -D_POSIX_C_SOURCE=200809L ${ext_system_includes} ${ext_includes} ${ext_opts}"
)

set(CDDS_LIB_DIR ${CMAKE_CURRENT_BINARY_DIR}/cyclonedds-prefix/lib)
set(CDDS_INCLUDE_DIR ${CMAKE_CURRENT_BINARY_DIR}/cyclonedds-prefix/include)

ExternalProject_Add(cyclonedds
  SOURCE_DIR ${CMAKE_CURRENT_SOURCE_DIR}/../../
  BUILD_COMMAND ${CMAKE_COMMAND} --build .
  CMAKE_ARGS
  -DBUILD_SHARED_LIBS=0 -DENABLE_SECURITY=0 -DENABLE_SSL=0 -DENABLE_SOURCE_SPECIFIC_MULTICAST=0 -DENABLE_IPV6=1 -DENABLE_ICEORYX=0 -DWITH_ZEPHYR=1
    # Do not build the host-side tools (dyntypelib/xmltype): they are linked
    # with the host compiler against the Zephyr-targeted libddsc.a. The three
    # options form a dependency chain, so turn them off together.
    -DENABLE_TYPELIB=0 -DENABLE_TYPE_DISCOVERY=0 -DENABLE_TOPIC_DISCOVERY=0
    -DCMAKE_TRY_COMPILE_TARGET_TYPE=STATIC_LIBRARY
    -DCMAKE_INSTALL_PREFIX=<INSTALL_DIR>
    -DCMAKE_VERBOSE_MAKEFILE=1
    -DCMAKE_C_FLAGS=${CDDS_CFLAGS}
    -DCMAKE_C_COMPILER=${CMAKE_C_COMPILER}
    -DCMAKE_SYSTEM_NAME=Generic
    -DCMAKE_BUILD_TYPE=Debug
  DEPENDS zephyr_interface
  BUILD_BYPRODUCTS ${CDDS_LIB_DIR}/libddsc.a
)
add_library(cdds_lib STATIC IMPORTED GLOBAL)
add_dependencies(cdds_lib cyclonedds)
set_target_properties(cdds_lib PROPERTIES IMPORTED_LOCATION ${CDDS_LIB_DIR}/libddsc.a)

target_include_directories(app PUBLIC ${CDDS_INCLUDE_DIR})
target_link_libraries(app PUBLIC cdds_lib)

if (BUILD_DDSPERF_PING OR BUILD_DDSPERF_PONG)
  GENERATE_CDDS_CONF("config.xml" "${CDDS_INCLUDE_DIR}/ddsperf_config.h")
  target_compile_definitions(app
    PRIVATE
    BUILD_DDSPERF_PING=${BUILD_DDSPERF_PING}
    BUILD_DDSPERF_PONG=${BUILD_DDSPERF_PONG})
  target_sources(app
    PRIVATE
    src/ddsperf_main.c
    src/ddsperf.c
    src/ddsperf_types.c src/ddsperf_types.h
    src/cputime.c src/cputime.h
    src/netload.c src/netload.h
    src/async_listener.c src/async_listener.h
  )
elseif(BUILD_ROUNDTRIP_PING OR BUILD_ROUNDTRIP_PONG)
  GENERATE_CDDS_CONF("config.xml" "${CDDS_INCLUDE_DIR}/roundtrip_config.h")
  target_compile_definitions(app
    PRIVATE
    BUILD_ROUNDTRIP_PING=${BUILD_ROUNDTRIP_PING}
    BUILD_ROUNDTRIP_PONG=${BUILD_ROUNDTRIP_PONG})
  target_sources(app
    PRIVATE
    src/roundtrip_main.c
    src/RoundTrip.c src/RoundTrip.h
    src/ping.c src/pong.c)
elseif(BUILD_THROUGHPUT_PUB OR BUILD_THROUGHPUT_SUB)
  GENERATE_CDDS_CONF("config.xml" "${CDDS_INCLUDE_DIR}/throughput_config.h")
  target_compile_definitions(app
    PRIVATE
    BUILD_THROUGHPUT_PUB=${BUILD_THROUGHPUT_PUB}
    BUILD_THROUGHPUT_SUB=${BUILD_THROUGHPUT_SUB})
  target_sources(app
    PRIVATE
    src/throughput_main.c
    src/Throughput.c src/Throughput.h
    src/subscriber.c src/publisher.c)

elseif(BUILD_HELLOWORLD_PUB OR BUILD_HELLOWORLD_SUB)
  # Absolute path: GENERATE_CDDS_CONF feeds the file to the xxd subprocess,
  # which resolves relative paths against the build directory.
  GENERATE_CDDS_CONF("${CMAKE_CURRENT_SOURCE_DIR}/config.xml" "${CDDS_INCLUDE_DIR}/helloworld_config.h")
  target_compile_definitions(app
    PRIVATE
    BUILD_HELLOWORLD_PUB=${BUILD_HELLOWORLD_PUB}
    BUILD_HELLOWORLD_SUB=${BUILD_HELLOWORLD_SUB})
  target_sources(app
    PRIVATE
    src/helloworld_main.c
    src/helloworld_pub.c
    src/helloworld_sub.c
    src/HelloWorldData.c
    src/HelloWorldData.h
  )
endif()
```

## sample.yaml
```
sample:
  name: Cyclone DDS
  description: Creates a DDS domain and participant and reads it back from the DCPSParticipant built-in topic
tests:
  sample.cyclonedds.selftest:
    tags:
      - dds
      - net
    platform_allow:
      - native_sim/native/64
    integration_platforms:
      - native_sim/native/64
    harness: console
    harness_config:
      type: one_line
      regex:
        - "cyclonedds: self-test passed"
    timeout: 60
```

## prj.conf
```kconfig
CONFIG_NEWLIB_LIBC=y
CONFIG_NEWLIB_LIBC_NANO=n
CONFIG_MAIN_STACK_SIZE=131072
CONFIG_NET_HOSTNAME_ENABLE=y

CONFIG_POSIX_API=y

CONFIG_THREAD_LOCAL_STORAGE=y
CONFIG_THREAD_NAME=y

CONFIG_NETWORKING=y
CONFIG_NET_IPV4=y
CONFIG_NET_IPV6=y
CONFIG_NET_SOCKETS=y

CONFIG_LOG=y
CONFIG_LOG_MODE_IMMEDIATE=y

CONFIG_ENTROPY_GENERATOR=y
CONFIG_TEST_RANDOM_GENERATOR=y

CONFIG_POSIX_THREAD_THREADS_MAX=10
CONFIG_MAX_PTHREAD_MUTEX_COUNT=300
CONFIG_MAX_PTHREAD_COND_COUNT=150
CONFIG_NET_SOCKETS_POLL_MAX=6

CONFIG_IDLE_STACK_SIZE=4096
CONFIG_SYSTEM_WORKQUEUE_STACK_SIZE=8192

CONFIG_NET_TX_STACK_SIZE=32768
CONFIG_NET_RX_STACK_SIZE=32768
CONFIG_NET_PKT_RX_COUNT=64
CONFIG_NET_PKT_TX_COUNT=64
CONFIG_NET_BUF_RX_COUNT=512
CONFIG_NET_BUF_TX_COUNT=256
CONFIG_NET_CONTEXT_NET_PKT_POOL=y
CONFIG_NET_MGMT_EVENT_STACK_SIZE=8192
CONFIG_NET_DEBUG_MGMT_EVENT_STACK=y
CONFIG_NET_BUF_DATA_SIZE=512

CONFIG_NET_CONFIG_SETTINGS=y
##CONFIG_NET_CONFIG_NEED_IPV6=y
##CONFIG_NET_CONFIG_MY_IPV6_ADDR="2001:db8::1"
#CONFIG_NET_CONFIG_PEER_IPV6_ADDR="2001:db8::2"
CONFIG_NET_CONFIG_NEED_IPV4=y
CONFIG_NET_CONFIG_MY_IPV4_ADDR="192.0.2.1"
#CONFIG_NET_CONFIG_PEER_IPV4_ADDR="192.0.2.2"

CONFIG_NET_SOCKETPAIR=y
CONFIG_NET_IPV4_IGMP=y
CONFIG_NET_IF_MCAST_IPV6_ADDR_COUNT=5
CONFIG_NET_IF_MCAST_IPV4_ADDR_COUNT=5

CONFIG_THREAD_RUNTIME_STATS=y
CONFIG_NUM_COOP_PRIORITIES=0
CONFIG_NET_TC_RX_COUNT=0
```

## overlay-e1000.conf
```kconfig
# Overlay for experimental TCP as qemu_x86 with E1000

CONFIG_PCIE=y

#CONFIG_NET_SLIP_TAP=y
CONFIG_NET_L2_ETHERNET=y

CONFIG_NET_QEMU_ETHERNET=y
#CONFIG_NET_QEMU_SLIP=y
#CONFIG_NET_LOOPBACK=y

#CONFIG_ETHERNET_LOG_LEVEL_DBG=y

CONFIG_NET_IPV4_FRAGMENT=y
CONFIG_NET_IPV6_FRAGMENT=y

# Static address; use CONFIG_NET_DHCPV4=y instead if a DHCP server is available.
CONFIG_NET_CONFIG_SETTINGS=y
CONFIG_NET_CONFIG_NEED_IPV4=y
CONFIG_NET_CONFIG_MY_IPV4_ADDR="192.0.2.1"

# With an MMU the default malloc arena is only 16 KiB; DDS needs considerably more.
CONFIG_COMMON_LIBC_MALLOC_ARENA_SIZE=8388608
# qemu_x86 maps only 8 MiB of kernel virtual memory by default, not enough for the above.
CONFIG_KERNEL_VM_SIZE=0x1000000
```

## boards/native_sim_native_64.conf
```kconfig
# Loopback only, so the self-test runs without a TAP device (e.g. in CI).
CONFIG_NET_DRIVERS=y
CONFIG_NET_LOOPBACK=y
CONFIG_ETH_NATIVE_TAP=n
# The native_sim default heap is 16 KiB; DDS needs considerably more.
CONFIG_COMMON_LIBC_MALLOC_ARENA_SIZE=8388608
```

## boards/qemu_x86.conf
```kconfig
CONFIG_NET_LOG=y
CONFIG_NET_CORE_LOG_LEVEL_DEFAULT=y
#CONFIG_LOG_DEFAULT_LEVEL=4

# debug (GDBSTUB makes the image wait for a debugger on the serial port at boot)
#CONFIG_GDBSTUB=y
#CONFIG_DEBUG=y
#CONFIG_STACK_SENTINEL=y
#CONFIG_STACK_CANARIES=y
#CONFIG_DEBUG_COREDUMP=y
#CONFIG_DEBUG_COREDUMP_BACKEND_LOGGING=y
#CONFIG_NO_OPTIMIZATIONS=y
```

## boards/s32z270dc2_rtu0_r52.conf
```kconfig
CONFIG_NET_L2_ETHERNET=y

CONFIG_NET_IPV4_FRAGMENT=y
CONFIG_NET_IPV6_FRAGMENT=y
CONFIG_NET_BUF_DATA_SIZE=1024

CONFIG_ETH_NXP_S32_TX_RING_LEN=64
CONFIG_ETH_NXP_S32_RX_RING_LEN=64
CONFIG_ETH_NXP_S32_RX_IRQ_PACKET_THRESHOLD=8

CONFIG_ETH_NXP_S32_RX_THREAD_STACK_SIZE=8192

# For ipv4 multicast receive:
CONFIG_NET_PROMISCUOUS_MODE=y

# for net shell
CONFIG_NET_SHELL=y
CONFIG_NET_STATISTICS=y
CONFIG_NET_BUF_POOL_USAGE=y

# debug
#CONFIG_GDBSTUB=y
#CONFIG_DEBUG=y
#CONFIG_STACK_SENTINEL=y
#CONFIG_STACK_CANARIES=y
#CONFIG_DEBUG_COREDUMP=y
#CONFIG_DEBUG_COREDUMP_BACKEND_LOGGING=y
#CONFIG_NO_OPTIMIZATIONS=y
CONFIG_NET_LOG=y
CONFIG_NET_CORE_LOG_LEVEL_DEFAULT=y
#CONFIG_LOG_DEFAULT_LEVEL=3
```

## boards/s32z2xxdc2_s32z270_rtu0.conf
```kconfig
CONFIG_NET_L2_ETHERNET=y

CONFIG_NET_IPV4_FRAGMENT=y
CONFIG_NET_IPV6_FRAGMENT=y
CONFIG_NET_BUF_DATA_SIZE=1024

CONFIG_ETH_NXP_S32_TX_RING_LEN=64
CONFIG_ETH_NXP_S32_RX_RING_LEN=64
CONFIG_ETH_NXP_S32_RX_IRQ_PACKET_THRESHOLD=8

CONFIG_ETH_NXP_S32_RX_THREAD_STACK_SIZE=8192

# For ipv4 multicast receive:
CONFIG_NET_PROMISCUOUS_MODE=y

# for net shell
CONFIG_NET_SHELL=y
CONFIG_NET_STATISTICS=y
CONFIG_NET_BUF_POOL_USAGE=y

# debug
#CONFIG_GDBSTUB=y
#CONFIG_DEBUG=y
#CONFIG_STACK_SENTINEL=y
#CONFIG_STACK_CANARIES=y
#CONFIG_DEBUG_COREDUMP=y
#CONFIG_DEBUG_COREDUMP_BACKEND_LOGGING=y
#CONFIG_NO_OPTIMIZATIONS=y
CONFIG_NET_LOG=y
CONFIG_NET_CORE_LOG_LEVEL_DEFAULT=y
#CONFIG_LOG_DEFAULT_LEVEL=3

# Static address; use CONFIG_NET_DHCPV4=y instead if a DHCP server is available.
CONFIG_NET_CONFIG_SETTINGS=y
CONFIG_NET_CONFIG_NEED_IPV4=y
CONFIG_NET_CONFIG_MY_IPV4_ADDR="192.0.2.1"
```

## boards/s32z270dc2_rtu0_r52.overlay
```dts
/* Define 7M sram ragion to override 1M sram0 (for RTU0 only) */
/{
	soc {
		sram2: memory@32100000 {
			compatible = "mmio-sram";
			reg = <0x32100000 DT_SIZE_M(7)>;
		};
	};

	chosen {
		zephyr,sram = &sram2;
	};
};
```

## src/main.c
```c
// Copyright(c) 2026 ZettaScale Technology and others
//
// This program and the accompanying materials are made available under the
// terms of the Eclipse Public License v. 2.0 which is available at
// http://www.eclipse.org/legal/epl-2.0, or the Eclipse Distribution License
// v. 1.0 which is available at
// http://www.eclipse.org/org/documents/edl-v10.php.
//
// SPDX-License-Identifier: EPL-2.0 OR BSD-3-Clause

// Self-test for the Zephyr port: creates a domain and a participant and reads the
// participant back from the DCPSParticipant built-in topic.  Needs neither a peer nor
// IDL-generated code, so it doubles as the CI smoke test (see sample.yaml).

#include <stdio.h>

#ifdef CONFIG_ARCH_POSIX
#include "posix_board_if.h"
#endif

#include "dds/dds.h"
#include "dds/ddsi/ddsi_config.h"

static int finish (int rc)
{
  printf ("cyclonedds: self-test %s\n", rc == 0 ? "passed" : "FAILED");
  fflush (stdout);
#ifdef CONFIG_ARCH_POSIX
  // On native_sim the simulator keeps running after main returns; terminate it
  // so that "west build -t run" returns and the exit code reflects the result.
  posix_exit (rc);
#endif
  return rc;
}

#define CHECK(x) do { \
    const dds_return_t ret_ = (x); \
    if (ret_ < 0) { \
      printf ("cyclonedds: %s: %s\n", #x, dds_strretcode (ret_)); \
      return finish (1); \
    } \
  } while (0)

int main (void)
{
  struct ddsi_config cfg;
  dds_entity_t dom, pp, rd;
  void *samples[1] = { NULL };
  dds_sample_info_t info;
  dds_return_t n = 0;

  printf ("cyclonedds: self-test on %s\n", CONFIG_BOARD_TARGET);

  // Static configuration instead of CYCLONEDDS_URI; sized for a small receive buffer and
  // without multicast so it also works on a loopback-only system such as native_sim.
  ddsi_config_init_default (&cfg);
  cfg.rbuf_size = 40 * 1024;
  cfg.rmsg_chunk_size = 20 * 1024;
  cfg.multiple_recv_threads = DDSI_BOOLDEF_FALSE;
  cfg.allowMulticast = DDSI_AMC_FALSE;
  cfg.tracemask = DDS_LC_ERROR | DDS_LC_WARNING;
  cfg.tracefile = "stdout";

  CHECK (dom = dds_create_domain_with_rawconfig (0, &cfg));
  CHECK (pp = dds_create_participant (0, NULL, NULL));
  CHECK (rd = dds_create_reader (pp, DDS_BUILTIN_TOPIC_DCPSPARTICIPANT, NULL, NULL));
  for (int i = 0; i < 50 && n == 0; i++)
  {
    CHECK (n = dds_take (rd, samples, &info, 1, 1));
    if (n == 0)
      dds_sleepfor (DDS_MSECS (100));
  }
  if (n == 1)
    CHECK (dds_return_loan (rd, samples, n));
  CHECK (dds_delete (dom));

  return finish ((n == 1 && info.valid_data) ? 0 : 1);
}
```

## src/ddsperf_main.c
```c
/* #include <zephyr/kernel.h> */

#include <stdio.h>
#include <stdlib.h>
#include <dds/ddsrt/environ.h>

#include "ddsperf_config.h"

int ddsperf_main(int argc, char **argv);

char **environ = (char*[]) {
  (char*)&cdds_xml_config,
  NULL
};

int main(void)
{
    printf("CycloneDDS DDSPerf (%s)\n", CONFIG_BOARD);
#if BUILD_DDSPERF_PING
    char *args[] = { "ddsperf", "ping" };
#else
    char *args[] = { "ddsperf", "pong" };
#endif
    ddsperf_main(sizeof(args)/sizeof(args[0]), args);
    printf("Done\n");
    return 0;
}
```

## src/helloworld_main.c
```c
#include <zephyr/kernel.h>

#include <stdio.h>
#include <stdlib.h>
#include <dds/dds.h>
#include <dds/ddsrt/heap.h>
#include <dds/ddsi/ddsi_config.h>
#include "HelloWorldData.h"

void init_config(struct ddsi_config *cfg)
{
  ddsi_config_init_default (cfg);
  cfg->rbuf_size = 40 * 1024;
  cfg->rmsg_chunk_size = 20 * 1024;
  //cfg->tracemask = DDS_LC_ALL;
  cfg->tracemask = DDS_LC_INFO | DDS_LC_CONFIG;
  cfg->tracefile = "stderr";
  cfg->tracefp = NULL;
  cfg->multiple_recv_threads = DDSI_BOOLDEF_FALSE;
  //cfg->max_msg_size = 1452;
  cfg->retransmit_merging = DDSI_REXMIT_MERGE_ALWAYS;
  //cfg->transport_selector = DDSI_TRANS_UDP6;
  //cfg->defaultMulticastAddressString = "239.255.0.2";

  struct ddsi_config_network_interface_listelem *ifcfg = ddsrt_malloc (sizeof (*ifcfg));
  memset(ifcfg, 0, sizeof *ifcfg);
  ifcfg->next = NULL;
  ifcfg->cfg.prefer_multicast = true;
#if defined(CONFIG_BOARD_QEMU_X86)
  ifcfg->cfg.name = "eth0";
#elif defined(CONFIG_BOARD_S32Z2XXDC2)
  ifcfg->cfg.name = "ethernet@74b00000";
#endif
  cfg->network_interfaces = ifcfg;
  
#if defined(CONFIG_NET_CONFIG_PEER_IPV6_ADDR)
  if (strlen(CONFIG_NET_CONFIG_PEER_IPV6_ADDR) > 0) {
    struct ddsi_config_peer_listelem *peer = ddsrt_malloc (sizeof (*peer));
    peer->next = NULL;
    peer->peer = CONFIG_NET_CONFIG_PEER_IPV6_ADDR;
    cfg->peers = peer;
  }
#elif defined(CONFIG_NET_CONFIG_PEER_IPV4_ADDR)
  if (strlen(CONFIG_NET_CONFIG_PEER_IPV4_ADDR) > 0)) {
    struct ddsi_config_peer_listelem *peer = ddsrt_malloc (sizeof (*peer));
    peer->next = NULL;
    peer->peer = CONFIG_NET_CONFIG_PEER_IPV4_ADDR;
    cfg->peers = peer;
  }
#endif
}

void helloworld_publisher()
{
  dds_entity_t participant;
  dds_entity_t topic;
  dds_entity_t writer;
  dds_return_t rc;
  HelloWorldData_Msg msg;
  uint32_t status = 0;
  struct ddsi_config config;

  init_config(&config);
  dds_entity_t domain = dds_create_domain_with_rawconfig (1, &config);

  /* Create a Participant. */
  participant = dds_create_participant (1, NULL, NULL);
  if (participant < 0)
    DDS_FATAL("dds_create_participant: %s\n", dds_strretcode(-participant));

  /* Create a Topic. */
  topic = dds_create_topic (
    participant, &HelloWorldData_Msg_desc, "HelloWorldData_Msg", NULL, NULL);
  if (topic < 0)
    DDS_FATAL("dds_create_topic: %s\n", dds_strretcode(-topic));

  /* Create a Writer. */
  writer = dds_create_writer (participant, topic, NULL, NULL);
  if (writer < 0)
    DDS_FATAL("dds_create_writer: %s\n", dds_strretcode(-writer));

  printf("=== [Publisher]  Waiting for a reader to be discovered ...\n");
  fflush (stdout);

  rc = dds_set_status_mask(writer, DDS_PUBLICATION_MATCHED_STATUS);
  if (rc != DDS_RETCODE_OK)
    DDS_FATAL("dds_set_status_mask: %s\n", dds_strretcode(-rc));

  while(!(status & DDS_PUBLICATION_MATCHED_STATUS))
  {
    rc = dds_get_status_changes (writer, &status);
    if (rc != DDS_RETCODE_OK)
      DDS_FATAL("dds_get_status_changes: %s\n", dds_strretcode(-rc));

    /* Polling sleep. */
    dds_sleepfor (DDS_MSECS (20));
  }

  /* Create a message to write. */
  msg.userID = 1;
  msg.message = "Hello World";

  printf ("=== [Publisher]  Writing : ");
  printf ("Message (%"PRId32", %s)\n", msg.userID, msg.message);
  fflush (stdout);

  rc = dds_write (writer, &msg);
  if (rc != DDS_RETCODE_OK)
    DDS_FATAL("dds_write: %s\n", dds_strretcode(-rc));

  /* Deleting the participant will delete all its children recursively as well. */
  rc = dds_delete (participant);
  if (rc != DDS_RETCODE_OK)
    DDS_FATAL("dds_delete: %s\n", dds_strretcode(-rc));

  rc = dds_delete (domain);
  if (rc != DDS_RETCODE_OK)
    DDS_FATAL("dds_delete (domain): %s\n", dds_strretcode(-rc));
}

#define MAX_SAMPLES 1

void helloworld_subscriber()
{
  dds_entity_t participant;
  dds_entity_t topic;
  dds_entity_t reader;
  HelloWorldData_Msg *msg;
  void *samples[MAX_SAMPLES];
  dds_sample_info_t infos[MAX_SAMPLES];
  dds_return_t rc;
  dds_qos_t *qos;
  struct ddsi_config config;

  init_config(&config);
  dds_entity_t domain = dds_create_domain_with_rawconfig (1, &config);
  if (domain < 0)
      DDS_FATAL("dds_create_domain_with_rawconfig: %s\n", dds_strretcode(-domain));

  /* Create a Participant. */
  participant = dds_create_participant (1, NULL, NULL);
  if (participant < 0)
    DDS_FATAL("dds_create_participant: %s\n", dds_strretcode(-participant));

  /* Create a Topic. */
  topic = dds_create_topic (
    participant, &HelloWorldData_Msg_desc, "HelloWorldData_Msg", NULL, NULL);
  if (topic < 0)
    DDS_FATAL("dds_create_topic: %s\n", dds_strretcode(-topic));

  /* Create a reliable Reader. */
  qos = dds_create_qos ();
  dds_qset_reliability (qos, DDS_RELIABILITY_RELIABLE, DDS_SECS (10));

  reader = dds_create_reader (participant, topic, qos, NULL);
  if (reader < 0)
    DDS_FATAL("dds_create_reader: %s\n", dds_strretcode(-reader));
  dds_delete_qos(qos);

  printf ("\n=== [Subscriber] Waiting for a sample ...\n");
  fflush (stdout);

  /* Initialize sample buffer, by pointing the void pointer within
   * the buffer array to a valid sample memory location. */
  samples[0] = HelloWorldData_Msg__alloc ();

  /* Poll until data has been read. */
  while (true)
  {
    /* Do the actual read.
     * The return value contains the number of read samples. */
    rc = dds_read (reader, samples, infos, MAX_SAMPLES, MAX_SAMPLES);
    if (rc < 0)
      DDS_FATAL("dds_read: %s\n", dds_strretcode(-rc));

    /* Check if we read some data and it is valid. */
    if ((rc > 0) && (infos[0].valid_data))
    {
      /* Print Message. */
      msg = (HelloWorldData_Msg*) samples[0];
      printf ("=== [Subscriber] Received : ");
      printf ("Message (%"PRId32", %s)\n", msg->userID, msg->message);
      fflush (stdout);
      break;
    }
    else
    {
      /* Polling sleep. */
      dds_sleepfor (DDS_MSECS (20));
    }
  }

  /* Free the data location. */
  HelloWorldData_Msg_free (samples[0], DDS_FREE_ALL);

  /* Deleting the participant will delete all its children recursively as well. */
  rc = dds_delete (participant);
  if (rc != DDS_RETCODE_OK)
    DDS_FATAL("dds_delete (participant): %s\n", dds_strretcode(-rc));

  rc = dds_delete (domain);
  if (rc != DDS_RETCODE_OK)
    DDS_FATAL("dds_delete (domain): %s\n", dds_strretcode(-rc));
}

int main(void)
{
    printf("CycloneDDS Hello World! %s\n", CONFIG_BOARD);
#if BUILD_HELLOWORLD_PUB
    helloworld_publisher();
#else
    helloworld_subscriber();
#endif
    printf("Done\n");
    return 0;
}
```

## src/roundtrip_main.c
```c
/* #include <zephyr/kernel.h> */

#include <stdio.h>
#include <stdlib.h>
#include <dds/ddsrt/environ.h>

#include "roundtrip_config.h"

int roundtrip_ping(int argc, char **argv);
int roundtrip_pong(int argc, char **argv);

char **environ = (char*[]) {
  (char*)&cdds_xml_config,
  NULL
};

int main(void)
{
    int ret;
    printf("CycloneDDS Roundtrip (%s)\n", CONFIG_BOARD);
#if BUILD_ROUNDTRIP_PING
    char *args[] = { "RoundtripPing", "0", "0", "30" };
    ret = roundtrip_ping(sizeof(args)/sizeof(args[0]), args);
    printf("Finished (%d)\n", ret);

    if (ret == 0) {
        printf("Running RoundtripPing to send quit-message\n");
        char *quitargs[] = { "RoundtripPing", "quit" };
        ret = roundtrip_ping(sizeof(quitargs)/sizeof(quitargs[0]), quitargs);
    }

#else
    char *args[] = { "RoundtripPong" };
    ret = roundtrip_pong(sizeof(args)/sizeof(args[0]), args);
#endif
    printf("Done (ret=%d)\n", ret);
    return 0;
}
```

## src/throughput_main.c
```c
/* #include <zephyr/kernel.h> */

#include <stdio.h>
#include <stdlib.h>
#include <dds/ddsrt/environ.h>

#include "throughput_config.h"

int throughput_pub(int argc, char **argv);
int throughput_sub(int argc, char **argv);

char **environ = (char*[]) {
  (char*)&cdds_xml_config,
  NULL
};

int main(void)
{
    int ret;
    printf("CycloneDDS Throughput (%s)\n", CONFIG_BOARD);
#if BUILD_THROUGHPUT_PUB
    char *args[] = { "ThroughputPublisher", "8192", "0", "1", "30" };
    ret = throughput_pub(sizeof(args)/sizeof(args[0]), args);
#else
    char *args[] = { "ThroughputSubscriber", "30" };
    ret = throughput_sub(sizeof(args)/sizeof(args[0]), args);
#endif
    printf("Done (ret=%d)\n", ret);
    return 0;
}
```
